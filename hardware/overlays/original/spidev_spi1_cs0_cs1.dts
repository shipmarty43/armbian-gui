/dts-v1/;

/ {
	compatible = "allwinner,sun50i-h616";

	fragment@0 {
		target = <0xffffffff>;

		__overlay__ {
			#address-cells = <0x01>;
			#size-cells = <0x00>;
			cs-gpios = <0x00 0x00>;
			num-cs = <0x02>;
			status = "okay";

			spidev@0 {
				compatible = "rohm,dh2228fv";
				reg = <0x00>;
				spi-max-frequency = <0x2625a00>;
				status = "okay";
				phandle = <0x01>;
			};

			spidev@1 {
				compatible = "rohm,dh2228fv";
				reg = <0x01>;
				spi-max-frequency = <0x2625a00>;
				status = "okay";
				phandle = <0x02>;
			};
		};
	};

	__symbols__ {
		spidev0 = "/fragment@0/__overlay__/spidev@0";
		spidev1 = "/fragment@0/__overlay__/spidev@1";
	};

	__fixups__ {
		spi1 = "/fragment@0:target:0";
	};
};
