/dts-v1/;

/ {
	compatible = "allwinner,sun50i-h616";

	fragment@0 {
		target = <0xffffffff>;

		__overlay__ {
			#address-cells = <0x01>;
			#size-cells = <0x00>;
			cs-gpios = <0x00 0x00 0xffffffff 0x08 0x03 0x00 0xffffffff 0x08 0x04 0x00>;
			num-cs = <0x04>;
			status = "okay";

			spidev@0 {
				compatible = "rohm,dh2228fv";
				reg = <0x00>;
				spi-max-frequency = <0x989680>;
				status = "okay";
				phandle = <0x01>;
			};

			spidev@1 {
				compatible = "rohm,dh2228fv";
				reg = <0x01>;
				spi-max-frequency = <0x989680>;
				status = "okay";
				phandle = <0x02>;
			};

			spidev@2 {
				compatible = "rohm,dh2228fv";
				reg = <0x02>;
				spi-max-frequency = <0x989680>;
				status = "okay";
				phandle = <0x03>;
			};

			spidev@3 {
				compatible = "rohm,dh2228fv";
				reg = <0x03>;
				spi-max-frequency = <0x989680>;
				status = "okay";
				phandle = <0x04>;
			};
		};
	};

	__symbols__ {
		spidev0 = "/fragment@0/__overlay__/spidev@0";
		spidev1 = "/fragment@0/__overlay__/spidev@1";
		spidev2 = "/fragment@0/__overlay__/spidev@2";
		spidev3 = "/fragment@0/__overlay__/spidev@3";
	};

	__fixups__ {
		spi1 = "/fragment@0:target:0";
		pio = "/fragment@0/__overlay__:cs-gpios:8", "/fragment@0/__overlay__:cs-gpios:24";
	};
};
