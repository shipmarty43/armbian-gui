/dts-v1/;
/plugin/;

/* Direct-mounted Waveshare SPI/GNSS HAT. The kernel owns active-low NSS
 * on physical 40 (PI3). Only the SPI data/clock group uses the SPI mux. */
&spi1 {
    #address-cells = <1>;
    #size-cells = <0>;
    pinctrl-names = "default";
    pinctrl-0 = <&spi1_pins>;
    num-cs = <1>;
    cs-gpios = <&pio 8 3 1>;
    status = "okay";

    radio@0 {
        compatible = "semtech,sx1262", "armbian,spi-dev";
        reg = <0>;
        /* Semtech tSCK >= 62.5 ns. Clients default to 2 MHz. */
        spi-max-frequency = <16000000>;
    };
};
